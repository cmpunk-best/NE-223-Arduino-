#include <Arduino.h>
#include "ShiftIn.h"
#include "FindLine.h"
#include "CalculatePosition.h"

int latchPin = 8;
int dataPin = 9;
int clockPin = 7;
int interruptSignalPin = 4;
int checkReadySignalPin = 5;


//These variables will hold the data from each of the shift registers
byte xLineTop1 = 0;
byte xLineTop2 = 0;
byte xLineBottom1 = 0;
byte xLineBottom2 = 0;
byte yLineTop1 = 0;
byte yLineTop2 = 0;
byte yLineBottom1 = 0;
byte yLineBottom2 = 0;

//This is used to check the signal generated by arduino 2
int readySignal = 0;

//These are used to keep track of the lines which the ball has crossed
int presentXLine = 0;
int presentYLine = 0;
int previousXLine = 0;
int previousYLine = 0;

//These store the (x,y) coordinates of the current and previous position of the ball
int newPosition[] = {-1,-1};
int previousPosition[] = {-1,-1};

void setup() 
{
  Serial.begin(9600);


  pinMode(latchPin, OUTPUT);
  pinMode(dataPin, INPUT);
  pinMode(clockPin, OUTPUT);

  pinMode(interruptSignalPin, OUTPUT);
  pinMode(checkReadySignalPin, INPUT);

  digitalWrite(interruptSignalPin, 0);

}

void loop() 
{
  readySignal = digitalRead(checkReadySignalPin);
  
  //proceed only if arduino 2 is ready
  if(readySignal)
  {
    
    digitalWrite(latchPin, 1);
    delayMicroseconds(20);
    digitalWrite(latchPin, 0);

    //obtain the 64 bit data frm the shift registers
    xLineTop1 = get_sensor_data(dataPin, clockPin);
    xLineTop2 = get_sensor_data(dataPin,clockPin);
    xLineBottom1 = get_sensor_data(dataPin, clockPin);
    xLineBottom2 = get_sensor_data(dataPin,clockPin);
    yLineTop1 = get_sensor_data(dataPin,clockPin);
    yLineTop2 = get_sensor_data(dataPin,clockPin);
    yLineBottom1 = get_sensor_data(dataPin,clockPin);
    yLineBottom2 = get_sensor_data(dataPin,clockPin);



    //check if any line has been detected by the sensor data
    if(isLinePresent(xLineTop1, xLineTop2, xLineBottom1, xLineBottom2, yLineTop1, yLineTop2, yLineBottom1, yLineBottom2));
    {
      previousXLine = presentXLine;
      previousYLine = presentYLine;
      presentXLine = findXLine(xLineTop1, xLineTop2, xLineBottom1, xLineBottom2);
      presentYLine = findYLine(yLineTop1, yLineTop2, yLineBottom1, yLineBottom2); 
    

    
      previousPosition[0] = newPosition[0];
      previousPosition[1] = newPosition[1];

      //find the new target position for the motor based on the current and previous 
      //line information that the ball has crossed
      int* ptr = findNewPosition(presentXLine, previousXLine, presentYLine, previousYLine, previousPosition, newPosition);
      newPosition[0] = ptr[0];
      newPosition[1] = ptr[1];
    }

    //Communicate only if there is any change in the x coordinate of the target position
    if((newPosition[0] != previousPosition[0]))
    {
      digitalWrite(interruptSignalPin, 1);
      Serial.write(newPosition[0] );
      digitalWrite(interruptSignalPin,0);
    }


  }
  

}


